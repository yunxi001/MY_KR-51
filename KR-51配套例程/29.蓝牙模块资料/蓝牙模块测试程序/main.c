/**************************************************************************************
*功能：串口通信 												              *
*说明：通过串口发送一字节数据，串口返回一字节数据 
*硬件连接：在J10处插上跳线帽  1,3用跳线短路 2,4用跳线短路								  *
*作者：研发中心																		  *
*公司：科睿电子产品有限公司 														  *
*电话：0530-2897239   15192459227			  										  *
*地址：菏泽市开发区广州路与淮河路交叉口科睿电子产品有限公司 						  *
***************************************************************************************/
#include<reg52.h>
#include<intrins.h>

typedef unsigned int uint;
typedef unsigned char uchar ;
uchar R_data;
bit R_flag=0;
/********************************************************************
* 名称 : Uart_Init()
* 功能 : 串口初始化，晶振11.0592,波特率9600，使能了串口中断
* 输入 : 无
* 输出 : 无
***********************************************************************/
void Uart_Init(void)
{
     TMOD = 0x20;   //定时器工作在定时器1的方式2
     PCON = 0x00;   //不倍频
     SCON = 0x50;	//串口工作在方式1，并且启动串行接收	
     TH1 = 0xFd;    //设置波特率 9600
     TL1 = 0xFd;
     TR1 = 1;		//启动定时器1
	 ES = 1;		//开串口中断
	 EA = 1;		//开总中断		
}
/********************************************************************
* 名称 : Uart_SendByte(uchar Byte)
* 功能 : 串口发送1字节数据
* 输入 : 无
* 输出 : 无
***********************************************************************/
void Uart_SendByte(uchar Byte)
{
	SBUF =	Byte;
	while(!TI)                   //如果发送完毕，硬件会置位TI
	{
		_nop_();	
	}	
}
/********************************************************************
* 名称 : Main()
* 功能 : 主函数
* 输入 : 无
* 输出 : 无
***********************************************************************/
void main()
{
	Uart_Init();
	while(1)
	{
		if(R_flag==1)
		{
			Uart_SendByte(R_data );
			R_flag=0;
		}	
	}		
}
/********************************************************************
* 名称 : Uart_Int()
* 功能 : 串口中断子函数
* 输入 : 无
* 输出 : 无
***********************************************************************/
void Uart_Int(void) interrupt 4
{
//	static uchar i = 7;    //定义为静态变量，当重新进入这个子函数时 i 的值不会发生改变
	EA = 0;
	if(RI == 1)   //当硬件接收到一个数据时，RI会置位
	{
		R_data= SBUF; //这里减去48是因为从电脑中发送过来的数据是ASCII码。
		RI = 0;  
		R_flag=1; 
	}
	EA = 1;
}




