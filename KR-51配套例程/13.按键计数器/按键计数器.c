/**************************************************************************************
*功能：数码管显示(动态扫描)  												  		  *
*硬件连接：在J4处插上跳线帽  第一位数码管 位引脚-->P2.0								  *
*							 第二位数码管 位引脚-->P2.1								  *
*							 第三位数码管 位引脚-->P2.2								  *
*							 第四位数码管 位引脚-->P2.3								  *
*							 所有的数码管 段引脚-->P0								  *
*作者：研发中心																		  *
*公司：科睿电子产品有限公司 														  *
*电话：0530-2897239   15192459227			  										  *
*地址：菏泽市开发区广州路与淮河路交叉口科睿电子产品有限公司 						  *
***************************************************************************************/
#include <reg52.h>
typedef  unsigned char uchar ;
typedef  unsigned char uint ;
sbit P2_0 = P2^0;
sbit P2_1 = P2^1;
sbit P2_2 = P2^2;
sbit P2_3 = P2^3;

sbit P3_4 = P3^4;//	十位加一
sbit P3_5 = P3^5;//	个位加一

uchar code table[]={0xc0,0xf9,0xa4,0xb0,0x99,0x92,0x82,
                        0xf8,0x80,0x90};
/********************************************************************
* 名称 : Delay()
* 功能 : 延时
* 输入 : i
* 输出 : 无
***********************************************************************/
void delay(uchar i)
{
  uchar j,k; 
  for(j=i;j>0;j--)
    for(k=125;k>0;k--);
}

/********************************************************************
* 名称 : display()
* 功能 : 数码管显示函数
* 输入 : Dis_data
* 输出 : 无
***********************************************************************/
void display(uint Dis_data)
{
  
   P0=table[Dis_data/1000];
   P2_0 = 0;
   delay(2);
   P2_0 = 1;

   P0=table[Dis_data%1000/100];
   P2_1 = 0;
   delay(2);
   P2_1 = 1;

   P0=table[Dis_data%1000%100/10];
   P2_2 = 0;
   delay(2);
   P2_2 = 1;

    P0=table[Dis_data%10];
   P2_3 = 0;
   delay(2);
   P2_3 = 1;
   
}


/********************************************************************
* 名称 : main()
* 功能 : 主函数
* 输入 : 无
* 输出 : 无
***********************************************************************/
void main(void)
{
    unsigned int  a=0;
   
	while(1)
	{
		if(P3_4==0)	//个位加
		{
			delay(5);
			if(P3_4==0)
			{
			 	a++;
				if(a>9999)
					a=0;
				while(!P3_4); //松手检测
			}		
		}
		if(P3_5==0)//十位加
		{
			delay(5);
			if(P3_5==0)
			{
			 	a=a+10;
				if(a>9999)
					a=0;
				while(!P3_5);//松手检测   
			}
		
		}
		display(a);	 //显示

	}
}