
/**************************************************************************************
*功能：外部中断的使用.c												                  *
*说明：数码管显示99秒的倒计时                                                         *
* 描述    :  外部中断，是单片机最基本也是最重要的功能。
			 外部中断0端口P3.2按键，数码管加一。
			 外部中断1端口P3.3按键，数码管减一 
*硬件连接：在J4处插上跳线帽  第一位数码管 位引脚-->P2.0								  *
*							 第二位数码管 位引脚-->P2.1								  *
*							 第三位数码管 位引脚-->P2.2								  *
*							 第四位数码管 位引脚-->P2.3								  *
*							 所有的数码管 段引脚-->P0
*作者：研发中心																		  *
*公司：科睿电子产品有限公司 														  *
*电话：0530-2897239   15192459227			  										  *
*地址：菏泽市开发区广州路与淮河路交叉口科睿电子产品有限公司 						  *
***************************************************************************************/
#include<reg52.h>
#define uchar unsigned char
#define uint  unsigned int

				//	 0	   1	2	 3	  4	   5   6	7	 8	  9	   10
uchar code table[]={0xc0,0xf9,0xa4,0xb0,0x99,0x92,0x82,0xf8,0x80,0x90,0xbf};

sbit KEY1 = P3^2;
sbit KEY2 = P3^3;

sbit P2_0 = P2^0;
sbit P2_1 = P2^1;
sbit P2_2 = P2^2;
sbit P2_3 = P2^3;

uchar Count = 0;


/********************************************************************
* 名称 : Delay()
* 功能 : 延时,延时时间为 10ms * del
* 输入 : del
* 输出 : 无
***********************************************************************/
void Delay(uint del)
{
	uint i,j;
	for(i=0; i<del; i++)
		for(j=0; j<1827; j++)    
			;
}

/********************************************************************
* 名称 : Outside_Init()
* 功能 : 外部中断0,1 的初始化
* 输入 : 无
* 输出 : 无
***********************************************************************/
void Outside_Init(void)
{
	EX0 = 1;  //开外部中断0
	IT0 = 1;  //负边沿触发

	EX1 = 1;  //开外部中断1
	IT1 = 1;  //负边沿触发

	EA = 1;	  //开总中断
}

/********************************************************************
* 名称 : Outside_Int1()
* 功能 : 外部中断0 的中断处理
* 输入 : 无
* 输出 : 无
***********************************************************************/
void Outside_Int1(void) interrupt 0	using 1
{
	Delay(2);	//延时消抖
	if(Count>10)
		Count=0;
	Count++;
	Delay(30);	  //延时消抖
}
/********************************************************************
* 名称 : Outside_Int2()
* 功能 : 外部中断1 的中断处理
* 输入 : 无
* 输出 : 无
***********************************************************************/
void Outside_Int2(void) interrupt 2	using 1
{
	Delay(2);  //延时消抖
	if(Count==0)
		Count=10;
	Count--;
	Delay(30); //延时消抖
}
/********************************************************************
* 名称 : Main()
* 功能 : 外部中断试验主程序
* 输入 : 无
* 输出 : 无
***********************************************************************/
void Main(void)
{
	Outside_Init();
	P2_0 = P2_1 = P2_2 = P2_3 = 0;
	while(1)
	{
		P0 = table[Count % 10];
		Delay(2);
	}
}