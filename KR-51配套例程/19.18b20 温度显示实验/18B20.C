/**************************************************************************************
*功能：温度测量  															   		  *		  		 
*硬件连接：在J6处插上跳线帽  第一位数码管 位引脚-->P2.0								  *
*							 第二位数码管 位引脚-->P2.1								  *
*							 第三位数码管 位引脚-->P2.2								  *
*							 第四位数码管 位引脚-->P2.3								  *
*							 所有的数码管 段引脚-->P0								  *					                          
*			18B20温度传感器    --> P2.6												  *
*作者：研发中心																		  *
*公司：科睿电子产品有限公司 														  *
*电话：0530-2897239   15192459227			  										  *
*地址：菏泽市开发区广州路与淮河路交叉口科睿电子产品有限公司 						  *
***************************************************************************************/ 
#include <at89x51.h>

sbit DQ =     P2 ^ 6;  //定义端口DQ

sbit led1    =P2^0;
sbit led2    =P2^1;
sbit led3    =P2^2;
sbit led4    =P2^3;

unsigned char tx[10]={0,0,0x2E,0,0,0,0,0xDF,0x43,0x0A};

unsigned code table[]={0xc0,0xf9,0xa4,0xb0,0x99,0x92,0x82,
                        0xf8,0x80,0x90};
/********************************************************************
* 名称 : Delay()
* 功能 : 微秒级延时函数
* 输入 : num
* 输出 : 无
***********************************************************************/
void Delay(int num)//延时函数
{
	while(num--) ;
}
/********************************************************************
* 名称 : Delaynms()
* 功能 : 毫秒级延时函数
* 输入 : num
* 输出 : 无
***********************************************************************/
void Delaynms(unsigned int di) //延时
{
	unsigned int da,db;
 	for(da=0;da<di;da++)
   		for(db=0;db<100;db++);
}
/********************************************************************
* 名称 : Init_DS18B20()
* 功能 : 初始化ds1820
* 输入 : 无
* 输出 : dat
***********************************************************************/	
void Init_DS18B20(void)//初始化ds1820
{
	unsigned char x=0;
	DQ = 1;    //DQ复位
	Delay(8);  //稍做延时
	DQ = 0;    //单片机将DQ拉低
	Delay(80); //精确延时 大于 480us
	DQ = 1;    //拉高总线
	Delay(14);
	x=DQ;      //稍做延时后 如果x=0则初始化成功 x=1则初始化失败
	Delay(20);
}

/********************************************************************
* 名称 : ReadOneChar()
* 功能 : 从DS18B20读取一节数据
* 输入 : 无
* 输出 : dat
***********************************************************************/
unsigned char ReadOneChar(void)//读一个字节
{
	unsigned char i=0;
	unsigned char dat = 0;
	for (i=8;i>0;i--)
	{
		DQ = 0; // 给脉冲信号
		dat>>=1;
		DQ = 1; // 给脉冲信号
		if(DQ)
		dat|=0x80;
		Delay(4);
	}
	return(dat);
}

/********************************************************************
* 名称 : WriteOneChar()
* 功能 : 对DS18B20写一节数据
* 输入 : dat
* 输出 : 无
***********************************************************************/
void WriteOneChar(unsigned char dat)//写一个字节
{
	unsigned char i=0;
	for (i=8; i>0; i--)
	{
		DQ = 0;
		DQ = dat&0x01;
		Delay(2);
		DQ = 1;
		dat>>=1;
	}
}

/********************************************************************
* 名称 : ReadTemperature()
* 功能 : 读取数据  转换温度
* 输入 : 无
* 输出 : 无
***********************************************************************/
void ReadTemperature(void)//读取温度
{
	unsigned char a=0;
	unsigned char b=0;
	unsigned char Data_L=0;
	unsigned char num=0;

	Init_DS18B20();

	WriteOneChar(0xCC); // 跳过读序号列号的操作
	WriteOneChar(0x44); // 启动温度转换
	Init_DS18B20();
	WriteOneChar(0xCC); //跳过读序号列号的操作
	WriteOneChar(0xBE); //读取温度寄存器

	a=ReadOneChar();  //读低8位
	b=ReadOneChar(); //读高8位

    tx[0] = (a/16+b*16)/10;      //整数部分


	tx[1] = (a/16+b*16)%10; 

    Data_L=a&0X0F;
    for(num=3;num<7;num++)		 //小数部分
   {
      Data_L=Data_L*10;				 //10	   //100		//40		 //80
     tx[num]=Data_L/16;			 //0	  //6			//2			 //5
      Data_L=Data_L%16;				 //10	   //4			//8
	}

}
/********************************************************************
* 名称 : Display_SMG（）
* 功能 : 数码管显示函数
* 输入 : 无
* 输出 : 无
***********************************************************************/
void Display_SMG(void)
{
   unsigned char a;
   for(a=0;a<=50;a++)
   {
	   P0=table[tx[0]];
	   P2_0 = 0;
	   Delaynms(5);
	   P2_0 = 1;
	
	   P0=(table[tx[1]])&0x7f;
	   P2_1 = 0;
	   Delaynms(5);
	   P2_1 = 1;
	
	   P0=table[tx[3]];
	   P2_2 = 0;
	   Delaynms(5);
	   P2_2 = 1;
	
	   P0=table[tx[4]];
	   P2_3 = 0;
	   Delaynms(5);
	   P2_3 = 1;
   }
}

/*********************************************************************
* 名称 : main()
* 功能 : 主函数
* 输入 : 无
* 输出 : 无
***********************************************************************/
void main(void)
{  
	Init_DS18B20();
	while(1)
	{ 		
		ReadTemperature();	 //读取温度		
		Display_SMG();	  //显示
	} 	
}

