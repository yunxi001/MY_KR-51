/**************************************************************************************
*功能：独立按键功能测试  															  *
*说明：按下P35  LED向下移动一位														  *
*硬件连接：LED  在J3处插上跳线帽  													  *
*							 LED1-->P1.0											  *
*							 LED2-->P1.1											  *
*							 ....-->....											  *
*							 LED8-->P1.7					                          *
*			独立按键    Init0 --> P3.2												  *
*						Init1 --> P3.3												  *
*						P34   --> P3.4												  *
*						P35   --> P3.5												  *
*作者：研发中心																		  *
*公司：科睿电子产品有限公司 														  *
*电话：0530-2897239   15192459227			  										  *
*地址：菏泽市开发区广州路与淮河路交叉口科睿电子产品有限公司 						  *
***************************************************************************************/
#include <reg52.h>

sbit BY1=P3^4;       //定义按键的输入端S2键
unsigned char count; //按键计数,每按一下,count加1
unsigned char temp;
unsigned char a,b;

/********************************************************************
* 名称 : delay10ms()
* 功能 : 延时10ms
* 输入 : 无
* 输出 : 无
***********************************************************************/
void delay10ms(void) //延时程序
{
	unsigned char i,j;
	for(i=20;i>0;i--)
	for(j=248;j>0;j--);
}
/********************************************************************
* 名称 : key()
* 功能 : 按键扫描
* 输入 : 无
* 输出 : 无
***********************************************************************/
void key()           //按键判断程序
{
	if(BY1==0)  //判断是否按下键盘
	{
		delay10ms(); //延时,软件去干扰
		if(BY1==0)   //确认按键按下
		{
			count++;     //按键计数加1
			if(count==8) //计8次重新计数
			{
				count=0;    //将count清零
			}
		}
		while(BY1==0);//按键锁定,每按一次count只加1.
	}
}
/********************************************************************
* 名称 : move() 
* 功能 : 向左移动移动函数
* 输入 : 无
* 输出 : 无
***********************************************************************/
void move()         //广告灯向左移动移动函数
{
	a=temp<<count;
	b=temp>>(8-count);
	P1=a|b;
}

/********************************************************************
* 名称 : Main()
* 功能 : 主函数
* 输入 : 无
* 输出 : 无
***********************************************************************/
void main()
{
	count=0;  //初始华参数设置
	temp=0xfe;
	P1=0xff;
	P1=temp;
	while(1)  //永远循环,扫描判断按键是否按下
	{
		key();    //调用按键识别函数
		move();   //调用广告灯移动函数
	}
}



