/**************************************************************************************
*功能：LED流水灯                    												  *
*硬件连接：在J3处插上跳线帽  LED1-->P1.0											  *
*							 LED2-->P1.1											  *
*							 ....-->....											  *
*							 LED8-->P1.7											  *
*作者：研发中心																		  *
*公司：科睿电子产品有限公司 														  *
*电话：0530-2897239   15192459227			  										  *
*地址：菏泽市开发区广州路与淮河路交叉口科睿电子产品有限公司 						  *
***************************************************************************************/

#include <reg52.h>

char LED;

/********************************************************************
* 名称 : delay()
* 功能 : 延时
* 输入 : i
* 输出 : 无
***********************************************************************/
void delay(unsigned int i)
{
    unsigned char j;
    for(i; i > 0; i--)
        for(j = 255; j > 0; j--);

}
/********************************************************************
* 名称 : Main()
* 功能 : 主函数
* 输入 : 无
* 输出 : 无
***********************************************************************/ 
main()
{ 
  unsigned char i;
  
  while (1) 
  {	 LED = 0xfe;
	   
	   for (i = 0 ;i < 8 ; i++)
	  { 
	   P1  = LED;
	   delay(500);
	   LED = LED << 1;	     // 左移
	   LED = LED | 0x01;	 // 移位后，后面的位为高电平
	   if (LED == 0x7f)	 break;	  //提前退出 FOR 循环
	   }
	
	   for (i = 0 ;i < 8 ; i++)
	   {
		 
		  P1  = LED;
		  delay(500);
		  LED = LED >> 1;	 // 右移
		  LED = LED | 0x80;	 // 移位后，后面的位为高电平
	   
	   }

   }
 
}


