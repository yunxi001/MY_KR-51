/**************************************************************************************
*功能：串口发送试验												            		  *
*作者：研发中心																		  *
*公司：科睿电子产品有限公司 														  *
*电话：0530-2897239   15192459227			  										  *
*地址：菏泽市开发区广州路与淮河路交叉口科睿电子产品有限公司 						  *
***************************************************************************************/
#include<reg52.h>
#include<intrins.h>

typedef  unsigned char	uchar ;
typedef  unsigned int	uint ;
/********************************************************************
* 名称 : Com_Init()
* 功能 : 初始化串口程序，晶振11.0592, 波特率9600
* 输入 : 无
* 输出 : 无
***********************************************************************/
void Com_Init(void)
{
     TMOD = 0x20;
     PCON = 0x00;
     SCON = 0x50;			
     TH1 = 0xFd;
     TL1 = 0xFd;
     TR1 = 1;			
}

/********************************************************************
* 名称 : Main()
* 功能 : 主函数
* 输入 : 无
* 输出 : 无
***********************************************************************/
void Main()
{
	uchar i = 0;
	uchar code Buffer[] = "Welcome To The MCU World.     http://dianzidasai.taobao.com/        TEL：13954067903            ";	 //所要发送的数据
	uchar *p;
	Com_Init();
	p = Buffer;
	while(1)
	{
		
		SBUF = *p;
		while(!TI)                   //如果发送完毕，硬件会置位TI
		{
			_nop_();	
		}
		p++;
		if(*p == '\0') break;		//在每个字符串的最后，会有一个'\0'
		TI = 0;		                //TI清零
	}
	while(1);
}