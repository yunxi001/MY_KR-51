/**************************************************************************************
*功能：双LED流水                  													  *
*硬件连接：在J3处插上跳线帽  LED1-->P1.0											  *
*							 LED2-->P1.1											  *
*							 ....-->....											  *
*							 LED8-->P1.7											  *
*作者：研发中心																		  *
*公司：科睿电子产品有限公司 														  *
*电话：0530-2897239   15192459227			  										  *
*地址：菏泽市开发区广州路与淮河路交叉口科睿电子产品有限公司 						  *
***************************************************************************************/
#include <reg52.h>
#define uchar unsigned char 
#define uint unsigned int


uchar code table[]={0xfc,0xf9,0xf3,0xe7,0xcf,0x9f,0x3f};                      

/********************************************************************
* 名称 : Delay()
* 功能 : 延时函数
* 输入 : i
* 输出 : 无
***********************************************************************/
void delay(uint i)
{
  uint j,k; 
  for(j=i;j>0;j--)
    for(k=125;k>0;k--);
}

/********************************************************************
* 名称 :display()
* 功能 :显示子函数
* 输入 : 无
* 输出 : 无
***********************************************************************/
void display()
{
   uchar i;
   for(i=0;i<7;i++)
   {
      P1=table[i];
      delay(1000);
   }
  
}

/********************************************************************
* 名称 : Main()
* 功能 : 主程序
* 输入 : 无
* 输出 : 无
***********************************************************************/
void main(void)
{
	unsigned int  a;
	
	while(1)
	{ 	
		for(a=100;a>0;a--)
		{
			display();
		}		
	}
}